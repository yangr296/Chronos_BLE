## build/Kconfig/Kconfig.shield
```kconfig
osource "i:/ipg/boards/shields/*/Kconfig.shield"
osource "C:/ncs/v2.4.0/nrf/boards/shields/*/Kconfig.shield"
```

## build_1/Kconfig/Kconfig.shield
```kconfig
osource "c:/users/tyang296/nordic/ipg/boards/shields/*/Kconfig.shield"
osource "C:/ncs/v2.4.0/nrf/boards/shields/*/Kconfig.shield"
```

## build_1/Kconfig/Kconfig.shield.defconfig
```kconfig
osource "c:/users/tyang296/nordic/ipg/boards/shields/*/Kconfig.defconfig"
osource "C:/ncs/v2.4.0/nrf/boards/shields/*/Kconfig.defconfig"
```

## build_2/Kconfig/Kconfig.shield
```kconfig
osource "c:/users/richa/ipg/boards/shields/*/Kconfig.shield"
osource "C:/ncs/main/nrf/boards/shields/*/Kconfig.shield"
```

## build_2/Kconfig/Kconfig.shield.defconfig
```kconfig
osource "c:/users/richa/ipg/boards/shields/*/Kconfig.defconfig"
osource "C:/ncs/main/nrf/boards/shields/*/Kconfig.defconfig"
```
